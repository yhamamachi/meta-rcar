## meta-rcar-gen3-adas/conf/layer.conf
```bitbake
# We have a conf and classes directory, append to BBPATH
BBPATH .= ":${LAYERDIR}"

# We have a recipes directory, add to BBFILES
BBFILES += " \
    ${LAYERDIR}/recipes-*/*/*.bb \
    ${LAYERDIR}/recipes-*/*/*.bbappend \
"

BBFILE_COLLECTIONS += "rcar-gen3-adas"
BBFILE_PATTERN_rcar-gen3-adas := "^${LAYERDIR}/"
BBFILE_PRIORITY_rcar-gen3-adas = "7"

# Custom packages
IMAGE_INSTALL_append_rcar-gen3 = " \
    kernel-modules \
    kernel-devicetree \
    can-utils \
    libsocketcan \
    iproute2 \
    iproute2-tc \
    linuxptp \
    spidev-dbg spidev-test \
    e2fsprogs \
    e2fsprogs-tune2fs \
    ethtool \
    pciutils \
    usbutils \
    util-linux \
    mtd-utils \
    capture capture-drm \
    v4l2-fw \
    iperf \
    bonnie++ \
    lmbench \
    strace \
    libpcap \
    eglibc-utils \
    ldd \
    procps \
    rsync \
    mm-init \
    iio-utils \
    pulseaudio-server \
    pulseaudio-misc \
    pulseaudio-module-cli \
    pulseaudio-module-remap-sink \
    pulseaudio-module-remap-source \
    pulseaudio-module-loopback \
    gstreamer1.0-plugins-good-pulse \
    gdbserver \
    most-tools \
    perf \
    dropbear \
    opkg \
    git \
    git-perltools \
    subversion \
    nano \
    cmake \
    make \
    gcc \
    g++ \
    gdb \
    vim \
    trace-cmd \
    libyaml \
    libinput \
    linux-renesas-uapi \
    netevent \
"

# Radio packages
IMAGE_INSTALL_append_ulcb += " \
    si-tools \
    linux-firmware-wl18xx \
    wireless-tools \
    ti-bt \
    ti-bt-firmware \
    bluez5 \
    bluez5-testtools \
    pulseaudio-module-bluez5-device \
    pulseaudio-module-bluez5-discover \
    pulseaudio-module-bluetooth-discover \
    pulseaudio-module-bluetooth-policy \
    ofono \
    ofono-tests \
"

# IMP
IMAGE_INSTALL_append_r8a7797 += " \
    kernel-module-uio-imp \
    kernel-module-cmemdrv \
    udev-rules-cvlib \
"

IMAGE_INSTALL_append_r8a7798 += " \
    kernel-module-uio-imp \
    kernel-module-cmemdrv \
    udev-rules-cvlib \
"

# ISP
IMAGE_INSTALL_append_r8a7797 += " \
    kernel-module-uio-isp \
"

IMAGE_INSTALL_append_r8a7798 += " \
    kernel-module-uio-isp \
"

DISTRO_FEATURES_remove="x11"
DISTRO_FEATURES_append = " surroundview "
DISTRO_FEATURES_append = " opencv-sdk "
DISTRO_FEATURES_append = " bluetooth"
DISTRO_FEATURES_append = " pulseaudio"

IMAGE_INSTALL_remove = "gtk+3-demo clutter-1.0-examples"

EXTRA_IMAGE_FEATURES_append_rcar-gen3 = " eclipse-debug"

EX_IMG_FEATURES = " \
    dev-pkgs \
    tools-sdk \
    tools-profile \
    tools-debug \
    package-management \
"
EXTRA_IMAGE_FEATURES_append_r8a7797 += " ${EX_IMG_FEATURES}"
EXTRA_IMAGE_FEATURES_append_r8a7798 += " ${EX_IMG_FEATURES}"

PREFERRED_VERSION_opencv = "2.4%"
```

## meta-rcar-gen3-adas/conf/machine/include/r8a7797.inc
```bitbake
SOC_FAMILY =. "rcar-gen3:rcar-gen3-adas:"
require conf/machine/include/soc-family.inc
LINUXLIBCVERSION = "4.9"
```

## meta-rcar-gen3-adas/conf/machine/include/v3xsk.inc
```bitbake
# Device tree for V3xsk
KERNEL_DEVICETREE += " \
    renesas/r8a77970-es1-v3msk.dtb \
    renesas/r8a77970-es1-v3msk-vbm-v2.dtb \
    renesas/r8a77970-es1-v3msk-vbm-v3.dtb \
    renesas/r8a77970-es1-v3msk-vbm.dtb \
    renesas/r8a77970-es1-v3msk-view.dtb \
    renesas/r8a77970-v3msk.dtb \
    renesas/r8a77970-v3msk-vbm-v2.dtb \
    renesas/r8a77970-v3msk-vbm-v3.dtb \
    renesas/r8a77970-v3msk-vbm.dtb \
    renesas/r8a77970-v3msk-view.dtb \
    renesas/r8a77980-v3hsk.dtb \
    renesas/r8a77980-es2-v3hsk.dtb \
    renesas/r8a77980-v3hsk-vb-4ch.dtb \
    renesas/r8a77980-v3hsk-vb-8ch.dtb \
    renesas/r8a77980-v3hsk-vb-gmsl-8ch.dtb \
    renesas/r8a77980-v3hsk-vb-gmsl2-2x2.dtb \
    renesas/r8a77980-v3hsk-vb-gmsl2-4.dtb \
    renesas/r8a77980-v3hsk-vb-gmsl2-8.dtb \
    renesas/r8a77980-es2-v3hsk-vb-4ch.dtb \
    renesas/r8a77980-es2-v3hsk-vb-8ch.dtb \
    renesas/r8a77980-es2-v3hsk-vb-gmsl-8ch.dtb \
    renesas/r8a77980-es2-v3hsk-vb-gmsl2-2x2.dtb \
    renesas/r8a77980-es2-v3hsk-vb-gmsl2-4.dtb \
    renesas/r8a77980-es2-v3hsk-vb-gmsl2-8.dtb \
"
```

## meta-rcar-gen3-adas/conf/machine/v3hsk.conf
```bitbake
#@TYPE: Machine
#@NAME: V3HSK machine
#@DESCRIPTION: Machine configuration for running V3H Starter Kit

SOC_FAMILY = "r8a77980"

# V3H u-boot configure
UBOOT_CONFIG = "v3hsk"
UBOOT_CONFIG[v3hsk] = "r8a77980_v3hsk_defconfig"

# V3x configuration
require conf/machine/include/v3x.inc
require conf/machine/include/v3xsk.inc

IMAGE_FSTYPES_remove = "wic.gz wic.bmap wic.gz.sha256sum wic.gz.crc"

# Configuration for CR7 Loader
EXTRA_IMAGEDEPENDS += " cr7-loader"

# Configuration for ARM Trusted Firmware
EXTRA_IMAGEDEPENDS += " arm-trusted-firmware"
```

## meta-rcar-gen3-adas/conf/machine/v3msk.conf
```bitbake
#@TYPE: Machine
#@NAME: V3MSK machine
#@DESCRIPTION: Machine configuration for running V3M Starter Kit

SOC_FAMILY = "r8a77970"

# V3M u-boot configure
UBOOT_CONFIG = "v3msk"
UBOOT_CONFIG[v3hsk] = "r8a77970_v3msk_defconfig"

# V3x configuration
require conf/machine/include/v3x.inc
require conf/machine/include/v3xsk.inc

IMAGE_FSTYPES_remove = "wic.gz wic.bmap wic.gz.sha256sum wic.gz.crc"

# Configuration for CR7 Loader
EXTRA_IMAGEDEPENDS += " cr7-loader"

# Configuration for ARM Trusted Firmware
EXTRA_IMAGEDEPENDS += " arm-trusted-firmware"
```

## meta-rcar-gen3-addons/conf/layer.conf
```bitbake
# We have a conf and classes directory, append to BBPATH
BBPATH .= ":${LAYERDIR}"

# We have a recipes directory, add to BBFILES
BBFILES += " \
    ${LAYERDIR}/recipes-*/*/*.bb \
    ${LAYERDIR}/recipes-*/*/*.bbappend \
"

BBFILE_COLLECTIONS += "rcar-gen3-addons"
BBFILE_PATTERN_rcar-gen3-addons := "^${LAYERDIR}/"
BBFILE_PRIORITY_rcar-gen3-addons = "10"

IMAGE_INSTALL_append = " \
		mdadm \
		lighttpd \
		hdparm \
"
```

## meta-renesas-gen3/conf/layer.conf
```bitbake
# We have a conf and classes directory, append to BBPATH
BBPATH .= ":${LAYERDIR}"

# We have a recipes directory, add to BBFILES
BBFILES += " \
    ${LAYERDIR}/recipes-*/*/*.bb \
    ${LAYERDIR}/recipes-*/*/*.bbappend \
"

BBFILE_COLLECTIONS += "renesas-gen3"
BBFILE_PATTERN_renesas-gen3 := "^${LAYERDIR}/"
BBFILE_PRIORITY_renesas-gen3 = "7"

LAYERSERIES_COMPAT_renesas-gen3 = "dunfell"
```
